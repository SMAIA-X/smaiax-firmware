## main/Kconfig.projbuild
```kconfig
menu "SMAIAX Firmware Configuration"

config SMART_METER_ID
	string "Smart Meter Id"
	default "69d784b5-e709-4f2a-906c-217cd7d29a3f"
	help
		The id of the smart meter that is used in the SMAIAX Backend

config SMART_METER_KEY
    string "Smart Meter Key"
    default "0x68,0xFA,0xFA,0x68,0x53,0xFF,0x00,0x01,0x67,0xDB,0x00,0x00,0x00,0x00,0x00,0x00"
    help
		Enter the smart meter key as a comma-separated list of hexadecimal values.
	
config WIFI_SSID
    string "WiFi SSID"
    default "myssid"
    help
		SSID (network name) to connect to.

config WIFI_PASSWORD
    string "WiFi Password"
    default "mypassword"
    help
		WiFi password (WPA or WPA2) to use.

config MQTT_BROKER_URL
	string "MQTT Broker URL"
	default "mqtt://mqtt.eclipseprojects.io"
	help
		The MQTT Broker URL to connect to.
		
config MQTT_USERNAME
	string "MQTT Username"
	default "user"
	help
		The Username for connecting to the MQTT Broker.
		
config MQTT_PASSWORD
	string "MQTT Password"
	default "password"
	help
		The Password for connecting to the MQTT Broker.

endmenu
```
